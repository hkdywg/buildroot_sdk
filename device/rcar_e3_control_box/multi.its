## device/rcar_e3_control_box/multi.its
```
/*
 * U-Boot uImage source file with multiple kernels, ramdisks and FDT blobs
 */

/dts-v1/;

/ {
	description = "Various kernels, ramdisks and FDT blobs";
	#address-cells = <2>;

	images {
		kernel-1 {
			description = "kernel";
			data = /incbin/("./Image.gz");
			type = "kernel";
			arch = "arm64";
			os = "linux";
			compression = "gzip";
			load = <0x0 0x80080000>;
			entry = <0x0 0x80080000>;
			hash-2 {
				algo = "crc32";
			};
		};

		ramdisk-1 {
			description = "ramdisk";
			data = /incbin/("./ramfs.cpio.gz");
			type = "ramdisk";
			arch = "arm64";
			os = "linux";
			compression = "gzip";
			load = <00000000>;
			entry = <00000000>;
			hash-1 {
				algo = "crc32";
			};
		};

		fdt-1 {
			description = "fdt";
			data = /incbin/("./r8a77990-ebisu.dtb");
			type = "flat_dt";
			arch = "arm64";
			compression = "none";
			hash-1 {
				algo = "crc32";
			};
		};

	};

	/*CFG*/

};
```
